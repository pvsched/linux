## virt/pvsched/Kconfig
```kconfig
# SPDX-License-Identifier: GPL-2.0-only

config PVSCHED
	tristate "Paravirtualized scheduling host framework"
	depends on KVM_X86 && X86_64 && TRACEPOINTS
	help
	  Provide the pvsched host control device.  A VMM registers its vCPU
	  threads as runners and attaches each one's guest-shared page.  The
	  built-in default policy then adjusts that vCPU thread's host
	  scheduling from guest-published intent at x86 KVM run, entry, exit,
	  halt and interrupt-wake boundaries, within host-configured priority
	  and budget limits.

	  Only x86-64 KVM provides the run and entry hooks pvsched needs, and
	  the shared-page stride matches the x86 4 KiB page, so pvsched is
	  x86-64 only.

config PVSCHED_EVENT_SERVICE_KUNIT_TEST
	tristate "KUnit tests for the pvsched production event service" if !KUNIT_ALL_TESTS
	depends on KUNIT && PVSCHED && KVM && X86_64
	default KUNIT_ALL_TESTS
	help
	  Test complete first/last probe registration and real task-exit
	  notification through the pvsched event service: one
	  holder count covers every KVM hook and the exit tracepoint, and
	  concurrent first and last holders register and unregister the
	  set exactly once.

config PVSCHED_SHM_KUNIT_TEST
	tristate "KUnit tests for pvsched shared-memory ownership" if !KUNIT_ALL_TESTS
	depends on KUNIT && PVSCHED && SHMEM
	default KUNIT_ALL_TESTS
	help
	  Test shared-page admission, charging, alias exclusion and
	  partial-failure unwind: which mappings are admitted, the global
	  page limit and memlock charge, refusing one physical page for
	  two attachments, and releasing every step exactly once.

config PVSCHED_SHM_BRIDGE_KUNIT_TEST
	tristate "KUnit tests for pvsched shared-memory bridge" if !KUNIT_ALL_TESTS
	depends on KUNIT && PVSCHED
	default KUNIT_ALL_TESTS
	help
	  Test the bridge that alone reads and writes a shared page: the
	  guest snapshot and its acknowledgment ordering, VMENTRY feedback,
	  the negotiation snapshot, and a response whose status is stored
	  last with release ordering.

config PVSCHED_NEGOTIATION_KUNIT_TEST
	tristate "KUnit tests for pvsched shared-page negotiation" if !KUNIT_ALL_TESTS
	depends on KUNIT && PVSCHED
	default KUNIT_ALL_TESTS
	help
	  Test the negotiation decision against the session's policy: the
	  fixed rejection order (ABI, name encoding, policy, version,
	  protocol, mode, guest fields, then the policy's own check),
	  policy-name encoding rules and the guest fields that must be zero
	  on a fresh attach.

config PVSCHED_POLICY_KUNIT_TEST
	tristate "KUnit tests for the pvsched host policy registry" if !KUNIT_ALL_TESTS
	depends on KUNIT && PVSCHED
	default KUNIT_ALL_TESTS
	help
	  Test host policy registration: the checks that refuse an invalid,
	  incomplete or duplicate policy, lookup by name and version, the
	  built-in default policy listed first, and an unregistered policy
	  that is no longer found while a reference keeps its entry alive.

config PVSCHED_CONTROL_KUNIT_TEST
	tristate "KUnit tests for pvsched shared-page control ioctls" if !KUNIT_ALL_TESTS
	depends on KUNIT && PVSCHED && KVM && X86_64 && MMU
	default KUNIT_ALL_TESTS
	help
	  Drive ATTACH_SHM and DETACH_SHM through the control device's ioctl
	  entry with a real anonymous guest page: enabled attach, rejection,
	  input errors, idempotent detach and final close.  The KUnit thread
	  is registered as the runner and given its own address space.  Also
	  test QUERY_POLICY and SET_POLICY: listing, the input checks,
	  selection exactly once and before any runner, the pin a session
	  holds until close, and a policy unregistered while in use.
```
